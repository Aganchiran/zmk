## app/dts/bindings/behaviors/zmk,behavior-key-hold-key-press.yaml
```yaml
# Copyright (c) 2021 The ZMK Contributors
# SPDX-License-Identifier: MIT

description: Key and key press/release behavior

compatible: "zmk,behavior-key-hold-key-press"

include: two_param.yaml
```

## app/dts/bindings/behaviors/zmk,behavior-key-space-press.yaml
```yaml
# Copyright (c) 2021 The ZMK Contributors
# SPDX-License-Identifier: MIT

description: Key and space press/release behavior

compatible: "zmk,behavior-key-space-press"

include: one_param.yaml
```

## app/dts/bindings/behaviors/zmk,behavior-pad-code.yaml
```yaml
# Copyright (c) 2021 The ZMK Contributors
# SPDX-License-Identifier: MIT

description: keypad code insert/release behavior

compatible: "zmk,behavior-pad-code"

include: two_param.yaml
```
